## src/build/Kconfig/Kconfig.soc
```kconfig
osource "/Users/valentin/research/official_repos/eAFH/src/zephyr/soc/$(ARCH)/*/Kconfig.soc"
```

## src/build/Kconfig/Kconfig.soc.arch
```kconfig
osource "/Users/valentin/research/official_repos/eAFH/src/zephyr/soc/$(ARCH)/Kconfig"
osource "/Users/valentin/research/official_repos/eAFH/src/zephyr/soc/$(ARCH)/*/Kconfig"
```
